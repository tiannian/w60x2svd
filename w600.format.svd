# w600 register map
File version: v0.1
Registers are 32-bit, read-write, reset 0x0 unless marked. A register's access mark holds for its fields unless they carry their own. Offsets are from the block's base; [hi:lo] are bit positions.

## gpioa
Base 0x40010C00
0x00 gpio_data reset 0x180B — 读写GPIO 当前数据
  [15:0] gpio — 当前数据，每BIT 与相应的GPIO 线对应
0x04 gpio_data_en reset 0xFFFF — 配置GPIO_DATA 的使能位
  [15:0] ? — 对应GPIO_DATA 的BIT 使能位，只有对应 BIT 为 1 时，对 GPIO_DATA 相应位的操作才有效，每BIT 与相应的GPIO 线对应，1’bx：[x] = 0, GPIO_DATA[x]不可读写[x] = 1, GPIO_DATA[x]可读写
0x08 gpio_dir — 配置GPIO 方向
  [15:0] gpio — 方向控制，每BIT 与相应的GPIO 线对应，
0x0C gpio_pull_en reset 0xFFFF — 配置GPIO 上下拉
  [15:0] gpio — 上下拉控制，每BIT 与相应的GPIO 线对应，该寄存器为低有效，一个GPIO 只有一种上下拉状态，IO 属性参见 IO 复用表
0x10 gpio_af_sel reset 0xFFFF — 配置GPIO 复用功能使能位
  [15:0] gpio — 复用功能使能位，每BIT 对应相应GPIO 复用功能是否打开，1’bx：[x] = 0, GPIO[x]复用功能关闭[x] = 1, GPIO[x]复用功能打开[x] = 1 时，复用功能取决于GPIO_AF_S1 和GPIO_AF_S0 两个寄存器相应BIT的状态。S1.[x] = 0， S0.[x] = 0，复用功能 1(opt1) S1.[x] = 0， S0.[x] = 1，复用功能 2(opt2) S1.[x] = 1， S0.[x] = 0，复用功能 3(opt3) S1.[x] = 1， S0.[x] = 1，复用功能 4(opt4)[x] = 0 时，如果GPIO_DIR[x] = 0，且 GPIO_PULL_EN[x] = 1，则 GPIO 复用为opt6 模拟 IO 功能IO 复用功能参见芯片引脚复用关系
0x14 gpio_sf_s1 — GPIO 复用功能选择位高地址位
  [15:0] gpio — 复用功能选择位高地址位，和GPIO_AF_S0 共同决定复用功能IO 复用功能参见芯片引脚复用关系
0x18 gpio_af_s0 — GPIO 复用功能选择位低地址位
  [15:0] gpio — 复用功能选择位低地址位，和GPIO_AF_S1 共同决定复用功能如何配置参见GPIO_AF_SEL 寄存器说明
0x20 gpio_is — 配置GPIO 的中断触发方式
  [15:0] gpio — 的中断触发方式，每BIT 与相应的GPIO 线对应，1’bx：[x] = 0, GPIO[x]中断为边沿触发[x] = 1, GPIO[x]中断为电平触发
0x24 gpio_ibe — 配置GPIO 中断边沿触发模式
  [15:0] gpio — 中断边沿触发模式，每BIT 与相应的GPIO 线对应，1’bx：[x] = 0, GPIO[x]边沿触发中断模式由GPIO_IEV 决定[x] = 1, GPIO[x]双沿都触发中断
0x28 gpio_iev — 配置 GPIO 中断上下边沿触发或高低电平触发
  [15:0] gpio — 中断上下边沿触发或高低电平触发选择，每BIT 与相应的GPIO 线对应，1’bx：[x] = 0, GPIO[x]中断为低电平或下降沿触发[x] = 1, GPIO[x]中断为高电平或上升沿触发
0x2C gpio_ie — 配置GPIO 中断使能
  [15:0] gpio — 中断使能控制，每BIT 与相应的GPIO 线对应，1’bx：[x] = 0, GPIO[x]中断失能[x] = 1, GPIO[x]中断使能
0x30 gpio_ris ro — 查询GPIO 裸中断状态（MASK 前）
  [15:0] gpio rw — 裸中断状态（MASK 前），每 BIT 与相应的GPIO 线对应，1’bx：[x] = 0, GPIO[x]没有中断产生[x] = 1, GPIO[x]有中断产生
0x34 gpio_mis ro — 查询 GPIO 屏蔽后中断状态（MASK后）
  [15:0] gpio rw — 屏蔽后中断状态（MASK 后），每 BIT 与相应的GPIO 线对应，1’bx：[x] = 0, GPIO[x]没有中断产生（MASK 后）[x] = 1, GPIO[x]中断产生（MASK 后）
0x38 gpio_ic — 控制GPIO 中断清除
  [15:0] gpio — 中断清除控制，每BIT 与相应的GPIO 线对应，1’bx：[x] = 0, 无动作[x] = 1, 清除GPIO[x]中断状态

## gpiob — GPIOA
Base 0x40011200
0x00 gpio_data reset 0x7304 — 读写GPIO 当前数据
  [31:0] gpio — 当前数据，每BIT 与相应的GPIO 线对应
0x04 gpio_data_en reset 0x7FFFFFFF — 配置GPIO_DATA 的使能位
  [31:0] ? — 对应GPIO_DATA 的BIT 使能位，只有对应 BIT 为 1 时，对 GPIO_DATA 相应位的操作才有效，每BIT 与相应的GPIO 线对应
0x08 gpio_dir — 配置GPIO 方向
  [31:0] gpio — 方向控制，每BIT 与相应的GPIO 线对应，1’bx：
0x0C gpio_pull_en reset 0xFFFFFFFF — 配置GPIO 上下拉
  [31:0] gpio — 上下拉控制，每BIT 与相应的GPIO 线对应，该寄存器为低有效，一个GPIO 只有一种上下拉状态，IO 属性参见 IO 复用表
0x10 gpio_af_sel reset 0xFFFFFFFF — 配置GPIO 复用功能使能位
  [31:0] gpio — 复用功能使能位，每BIT 对应相应GPIO 复用功能是否打开，1’bx：[x] = 0, GPIO[x]复用功能关闭[x] = 1, GPIO[x]复用功能打开[x] = 1 时，复用功能取决于GPIO_AF_S1 和GPIO_AF_S0 两个寄存器相应BIT的状态。S1.[x] = 0， S0.[x] = 0，复用功能 1(opt1) S1.[x] = 0， S0.[x] = 1，复用功能 2(opt2) S1.[x] = 1， S0.[x] = 0，复用功能 3(opt3) S1.[x] = 1， S0.[x] = 1，复用功能 4(opt4)IO 复用功能参见芯片引脚复用关系[x] = 0 时，如果GPIO_DIR[x] = 0，且 GPIO_PULL_EN[x] = 1，则 GPIO 复用为opt6 模拟 IO 功能
0x14 gpio_sf_s1 — GPIO 复用功能选择位高地址位
  [31:0] gpio — 复用功能选择位高地址位，和GPIO_AF_S0 共同决定复用功能IO 复用功能参见芯片引脚复用关系
0x18 gpio_af_s0 — GPIO 复用功能选择位低地址位
  [31:0] gpio — 复用功能选择位低地址位，和GPIO_AF_S1 共同决定复用功能如何配置参见GPIO_AF_SEL 寄存器说明
0x20 gpio_is — 配置GPIO 的中断触发方式
  [31:0] gpio — 的中断触发方式，每BIT 与相应的GPIO 线对应，1’bx：[x] = 0, GPIO[x]中断为边沿触发[x] = 1, GPIO[x]中断为电平触发
0x24 gpio_ibe — 配置GPIO 中断边沿触发模式
  [31:0] gpio — 中断边沿触发模式，每BIT 与相应的GPIO 线对应，1’bx：[x] = 0, GPIO[x]边沿触发中断模式由GPIO_IEV 决定[x] = 1, GPIO[x]双沿都触发中断
0x28 gpio_iev — 配置GPIO 中断上下边沿触发或 高低电平触发
  [31:0] gpio — 中断上下边沿触发或高低电平触发选择，每BIT 与相应的GPIO 线对应，1’bx：[x] = 0, GPIO[x]中断为低电平或下降沿触发[x] = 1, GPIO[x]中断为高电平或上升沿触发
0x2C gpio_ie — 配置GPIO 中断使能
  [31:0] gpio — 中断使能控制，每BIT 与相应的GPIO 线对应，1’bx：[x] = 0, GPIO[x]中断失能[x] = 1, GPIO[x]中断使能
0x30 gpio_ris ro — 查询 GPIO 裸中断状态（MASK前）
  [31:0] gpio rw — 裸中断状态（MASK 前），每 BIT 与相应的GPIO 线对应，1’bx：[x] = 0, GPIO[x]没有中断产生[x] = 1, GPIO[x]有中断产生
0x34 gpio_mis ro — 查询 GPIO 屏蔽后中断状态（MASK 后）
  [31:0] gpio rw — 屏蔽后中断状态（MASK 后），每 BIT 与相应的GPIO 线对应，1’bx：[x] = 0, GPIO[x]没有中断产生（MASK 后）[x] = 1, GPIO[x]中断产生（MASK 后）
0x38 gpio_ic — 控制GPIO 中断清除
  [31:0] gpio — 中断清除控制，每BIT 与相应的GPIO 线对应，1’bx：[x] = 0, 无动作[x] = 1, 清除GPIO[x]中断状态
