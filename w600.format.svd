# w600 register map
File version: v0.1
Registers are 32-bit, read-write, reset 0x0 unless marked. A register's access mark holds for its fields unless they carry their own. Offsets are from the block's base; [hi:lo] are bit positions.

## rst — Reset
Base 0x40013C00
0x00 sw_clkg_en reset 0x7FFF — 软件配置模块是否关断时钟
  [31:15] reserved — 保留
  [0] soft_7816_gate_en — 配置 7816/uart2 模块时钟的门控，默认 7816 模块门控开启
    0=7816 模块时钟关闭; 1=7816 时钟开启
  [0] soft_gpsec_gate_en — 配置gpsec 模块时钟的门控，默认gpsec 模块门控开启
    0=gpsec 模块时钟关闭; 1=gpsec 时钟开启
  [0] soft_rsa_gate_en — 配置RSA 时钟的门控，默认RSA 门控开启
    0=RSA 模块时钟关闭; 1=RSA 时钟开启
  [0] soft_i2s_gate_en — 配置i2s 时钟的门控，默认i2s 门控开启
    0=i2s 时钟关闭; 1=i2s 时钟开启
  [0] soft_lcd_gate_en — 配置lcd 时钟的门控，默认lcd 门控开启
    0=lcd 时钟关闭; 1=lcd 时钟开启
  [0] soft_pwm_gate_en — 配置pwm 时钟的门控，默认pwm 门控开启
    0=pwm 时钟关闭; 1=pwm 时钟开启
  [0] soft_sd_adc_gate_en — 配置sd_adc_时钟的门控，默认sd_adc_门控开启
    0=sd_adc_时钟关闭; 1=sd_adc_时钟开启
  [0] soft_gpio_gate_en — 配置GPIO 时钟的门控，默认GPIO 门控开启
    0=GPIO 时钟关闭; 1=GPIO 时钟开启
  [0] soft_timer_gate_en — 配置timer 时钟的门控，默认timer 门控开启
    0=timer 时钟关闭; 1=timer 时钟开启
  [0] soft_rf_cfg_gate_en — 内部使用，请勿修改。配置rf_cfg 时钟的门控，默认rf_cfg 门控开启
    0=rf_cfg 时钟关闭; 1=rf_cfg 时钟开启
  [0] soft_dma_gate_en — 表示供给dma 时钟域的时钟是否关断
    0=dma 时钟关闭; 1=dma 时钟开启
  [0] soft_ls_spi_gate_en — 配置低速spi 时钟的门控，默认低速spi 门控开启
    0=低速spi 时钟关闭; 1=低速spi 时钟开启
  [0] soft_uart1_gate_en — 配置uart1 时钟的门控，默认uart1 门控开启
    0=uart1 时钟关闭; 1=uart1 时钟开启
  [0] soft_uart0_gate_en — 配置uart0 时钟的门控，默认uart0 门控开启
    0=uart0 时钟关闭; 1=uart0 时钟开启
  [0] soft_i2c_gate_en — 配置i2c 时钟的门控，默认i2c 门控开启
    0=i2c 时钟关闭; 1=i2c 时钟开启
0x04 sw_clk_mask reset 0x7E — 软件配置模块是否自适应关断时钟
  [5:2] reserved — 保留，内部使用，请勿修改
  [0] soft_cpu_clk_gt_mask — 表示供给 CPU 时钟域（包括 CPU，bus1、ROM、SRAM）的时钟是否能够自适应的关断（当 CPU 需要进入WFI 状态的时候，不要设置自适应关断）
    0=允许自适应关断和开启; 1=不允许自适应关断和开启
  [0] soft_sdioahb_clk_gt_mask — 表示供给sdio ahb 时钟域的时钟是否能够自适应的关断
    0=允许自适应关断和开启; 1=不允许自适应关断和开启
  [0] soft_pmu_clk_gt_mask — pll 输出的时钟后有一个门控单元，采用该寄存器配置，表示是否允许被 PMU 关断。
    0=允许PMU 关断该门控单元，从而关断时钟; 1=不允许PMU 关断该门控单元
0x08 reserve access not given reset not defined
0x0C sw_rst_ctrl reset 0x1FFFFFF — 软件配置复位模块
  [31:25] reserved — 保留
  [0] soft_rst_7816_n — 软件复位 7816/uart2 模块
    0=复位; 1=复位释放
  [0] soft_rst_gpsec_n — 软件复位gpsec 模块
    0=复位; 1=复位释放
  [0] soft_rst_rsa_n — 软件复位RSA 模块
    0=复位; 1=复位释放
  [0] soft_rst_i2s_n — 软件复位i2s 模块
    0=复位; 1=复位释放
  [0] soft_rst_lcd_n — 软件复位lcd 模块
    0=复位; 1=复位释放
  [0] soft_rst_pwm_n — 软件复位pwm 模块
    0=复位; 1=复位释放
  [0] soft_rst_io_ctrl_n — 软件复位io_ctrl 模块
    0=复位; 1=复位释放
  [0] soft_rst_sar_adc_n — 软件复位sar_adc 模块
    0=复位; 1=复位释放
  [0] soft_rst_timer_n — 软件复位timer 模块
    0=复位; 1=复位释放
  [0] soft_rst_gpio_n — 软件复位gpio 模块
    0=复位; 1=复位释放
  [0] soft_rst_rf_cfg_n — 软件复位配置 RF 的寄存器模块(内部使用，请勿修改)
    0=复位; 1=复位释放
  [0] soft_rst_spis_n — 软件复位高速spi 模块
    0=复位; 1=复位释放
  [0] soft_rst_spim_n — 软件复位低速spi 模块
    0=复位; 1=复位释放
  [0] soft_rst_uart1_n — 软件复位片内uart1 模块
    0=复位; 1=复位释放
  [0] soft_rst_uart0_n — 软件复位片内uart0 模块
    0=复位; 1=复位释放
  [0] soft_rst_i2c_n — 软件复位片内i2c 模块
    0=复位; 1=复位释放
  [0] soft_rst_bus2_n — 软件复位片内bus2 模块
    0=复位; 1=复位释放
  [0] soft_rst_bus1_n — 软件复位片内bus1 模块
    0=复位; 1=复位释放
  [0] soft_rst_apb_n — 软件复位abp 桥接模块
    0=复位; 1=复位释放
  [0] soft_rst_mem_mng_n — 软件复位mem_mng 模块(内部使用，请勿修改)
    0=复位; 1=复位释放
  [0] soft_rst_dma_n — 软件复位dma 模块
    0=复位; 1=复位释放
  [0] soft_rst_sdio_ahb_n — 软件复位sdio ahb 时钟域模块
    0=复位; 1=复位释放
  [0] soft_rst_sec_n — 软件复位安全模块(内部使用，请勿修改)
    0=复位; 1=复位释放
  [0] soft_rst_mac_n — 软件复位mac 模块(内部使用，请勿修改)
    0=复位; 1=复位释放
  [0] soft_rst_bbp_n — 软件复位bbp 模块(内部使用，请勿修改)
    0=复位; 1=复位释放
0x10 sys_clk_div reset 0x2212 — 配置时钟分频比
  [30:29] reserved — 保留
  [27:12] sdadc_fdiv — clk_sar_adc 分频因子： 以 40M 为时钟源进行分频。分频系数即为所配分频值。
  [11:8] bus2_syncdn_factor — bus1 和bus2 的时钟比例关系，应该为N：1 其中N 为整数，在实际调整时，主要看CPU 的工作频率和bus2 的时钟频率之比。由于默认cpu 采用 80MHz 时钟，bus2 采用 40MHz 时钟，则 N=2
  [7:4] wlan_clk_divider — 从PLL 出来的时钟分频后，送给wlan 系统。本寄存器为分频因子，该因子>=1。默认分频因子为 1，即不对 pll 的 160MHz 输出分频，得到 160MHz 时钟，作为根节点时钟送给wlan（wlan 在继续分频得到更为详细的低频时钟）； 注：二级总线及APB 时钟为wlan 根节点时钟四分频
  [0] divide_freq_en — 当需要重新配置cpu_clk_divider ，wlan_clk_divider ，bus2_syncdn_factor，sdadc_fdiv时，置位本寄存器，硬件自动更新上述四个参数到分频器，然后清零本寄存器。 注：此处配置分频因子时，当Divide_freq_en 有效时，所有因子必须已经有效
    0=分频系数已生效; 1=要求硬件更新分频参数
  [0] rsa_clk_sel
    0=: 40MHz; 1=: 80MHz
  [3:0] cpu_clk_divider — 从PLL 出来的时钟分频后，送给CPU。本寄存器为分频因子，该因子>=2。 默认分频因子为 2，即复位释放后，对 PLL 输出的 160MHz 时钟 2 分频，送给 cpu 的是 80MHz 时钟。当需要调整cpu 所需时钟时，可以重新配置本参数
0x14 debug_ctrl — 配置ADC/DAC 回环测试
  [0] jtag — 使能
    0=: 禁止JTAG 调试功能; 1=: 使能JTAG 调试功能
  [4:0] reserved — 保留，请勿修改
0x18 i2s_clk_ctrl — 配置I2S 时钟
  [31:18] reserved — 保留
  [17:8] bclkdiv — BCLK 分配器：F_BCLK = F_I2SCLK / BCLKDIV 注意：如果未选择EXTAL_EN 而使用内部PLL 则F_I2SCLK =F_CPU (与CPU 频率相同)。 假设F_CPU = 160MHz，启用WXTAL_EN 时F_I2SCLK = 外部晶振频率， BCLKDIV = round (F_I2SCLK/(Fs*W*F)) 其中 Fs 是音频数据的采样频率，W 是字宽；数据为单声道时F = 1； 当数据为立体声时F = 2。 例如，如果使用内部 PLL 且数据宽度为 24 位，则格式为立体声格式，采样频率为 128KHz，BCLKDIV 应配置为（160 * 10e6 / 128 * 10e3 * 24 * 2）= 10'h1a。
  [7:2] mclkdiv — 如果选择外部时钟，则该MCLK 分频器用于产生适当的MCLK 频率。 F_mclk = F_I2SCLK / (2 * MCLKDIV)； 当MCLKDIV = 0 时F_I2SCLK 是外部时钟；当MCLKDIV >= 1 时F_mclk = F_I2SCLK； 注意：F_mclk 应配置为 256 * fs，其中 fs 是采样频率。
  [0] mclken — MCLK 使能开关
    0=禁止MCLK; 1=使能MCLK
  [0] extal_en — 外部时钟选择，选择使用内部I2S 块时钟还是外部时钟 注意：使用外部时钟时，外部时钟必须为 2 * N * 256 fs，其中 fs 为采样频率，N 必须为整数。
    0=内部时钟; 1=外部时钟
